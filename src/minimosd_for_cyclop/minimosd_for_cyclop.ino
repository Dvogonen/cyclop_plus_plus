/*******************************************************************************
  CYCLOP+ with OSD brings manual channel selection and onscreen information to
  the HobbyKing Quanum Cyclops FPV googles.

  The rx5808-pro and rx5808-pro-diversity projects served as a starting
  point for the code base, even if little of the actual code remains.
  Without those projects CYCLOP+ would not have been created. All possible
  credit goes to the two mentioned projects and their contributors.

  The OSD_Max7456 library from the night-ghost minimosd-extra project was used
  as a starting point for the MAX7456 library

  Copyright (c) 2016 Kjell Kernen (Dvogonen)

  Permission is hereby granted, free of charge, to any person obtaining a copy
  of this software and associated documentation files (the "Software"), to deal
  in the Software without restriction, including without limitation the rights
  to use, copy, modify, merge, publish, distribute, sublicense, and/or sell
  copies of the Software, and to permit persons to whom the Software is
  furnished to do so, subject to the following conditions:

  The above copyright notice and this permission notice shall be included in all
  copies or substantial portions of the Software.

  THE SOFTWARE IS PROVIDED "AS IS", WITHOUT WARRANTY OF ANY KIND, EXPRESS OR
  IMPLIED, INCLUDING BUT NOT LIMITED TO THE WARRANTIES OF MERCHANTABILITY,
  FITNESS FOR A PARTICULAR PURPOSE AND NONINFRINGEMENT. IN NO EVENT SHALL THE
  AUTHORS OR COPYRIGHT HOLDERS BE LIABLE FOR ANY CLAIM, DAMAGES OR OTHER
  LIABILITY, WHETHER IN AN ACTION OF CONTRACT, TORT OR OTHERWISE, ARISING FROM,
  OUT OF OR IN CONNECTION WITH THE SOFTWARE OR THE USE OR OTHER DEALINGS IN THE
  SOFTWARE.
********************************************************************************/

/*******************************************************************************
   Includes
 *******************************************************************************/
#include "max7456.h"
#include <SPI.h>

/*******************************************************************************
 Minimosd Display Protocol Definition v1.0
   Formal definition for the display protocol: (Token[Command[Param]])*
   Tokens,  commands and params are all bytes.
   All tokens except 0 results in the corresponding character in the Max7456 
   charmap being displayed onscreen  att current position using current paramss.
   The token 0 signals that the next byte is a command.
   Some commands have a single param.
   Invalid characters are ignored (e.g. unknown commands, params that are out of 
   bounds, etc).
 *******************************************************************************
 Protocol Commands:   
 *******************************************************************************/
#define CMD_CMD             0   /* The start command token.                    */
#define CMD_LOAD_CHARS      1   /* Load charset to EEPROM. Needed only once    */
#define CMD_CLEAR_SCREEN    2   /* Empties the screen                          */
#define CMD_ENABLE_OSD      3   /* Shows OSD on video out                      */
#define CMD_DISABLE_OSD     4   /* Hides OSD on video out                      */
#define CMD_ENABLE_VIDEO    5   /* Shows video in on video out                 */
#define CMD_DISABLE_VIDEO   6   /* Hides video in from video out               */
#define CMD_ENABLE_BLINK    7   /* All upcomming characters will blink         */
#define CMD_DISABLE_BLINK   8   /* All upcoming characters will be stable      */
#define CMD_ENABLE_REVERSE  9   /* All upcoming characters are inversed        */
#define CMD_DISABLE_REVERSE 10  /* All upcoming characters without inverse     */
#define CMD_NEWLINE         11  /* Moves cursor to start of the next line      */
#define CMD_SET_X           12  /* Position X cursor (next char is a parameter)*/
#define CMD_SET_Y           13  /* Position Y cursor (next char is a parameter)*/

/*******************************************************************************
   Hardware Defines
 *******************************************************************************/
#define LED_PIN     13
#define CS_PIN      10
#define MAX_LINES   13

/*******************************************************************************
   Character bitmaps stored in program memory. Needs more memory than in RAM
   0xFF is stored as 0x55 since program memory canmot hold series of 0xFF
 *******************************************************************************/
const char tableOfAllCharacters[13824] PROGMEM = {
  0x55, 0x55, 0x55, 0x54, 0x00, 0x15, 0x40, 0xaa,
  0x01, 0x4a, 0xaa, 0xa1, 0x4a, 0xaa, 0xa1, 0x4a,
  0xaa, 0xa1, 0x4a, 0xaa, 0xa1, 0x4a, 0xaa, 0xa1,
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  0x00, 0x00, 0x00, 0x00, 0x00, 0x00, 0x00, 0x00
};

/*******************************************************************************
   max7456 state variables. It is OK to use state values , but do not set them 
   directly. Use the set functions for manipulating the states.
 *******************************************************************************/
bool blinkState = false;
bool osdState = false;
bool inverseState = false;
bool videoState = false;

uint8_t curX = 0;        // May be directly manipulated
uint8_t curY = 0;        // May be directly manipulated

/*******************************************************************************
   Other Global Variables
 *******************************************************************************/
Max7456 *osd = NULL; //Pointer to a max7456 object
long systemPulseTimer = 0;

/*******************************************************************************
   Function: setBlinkState
 *******************************************************************************/
void setBlinkState( bool newState ) {
  if ( newState != blinkState) {
    blinkState = newState;
  }
}

/*******************************************************************************
   Function: setOSDState
 *******************************************************************************/
void setOsdState( bool newState ) {
  if ( newState != osdState) {
    osdState = newState;
    osd->activateOSD( osdState );
  }
}

/*******************************************************************************
   Function: setReverseCharState
 *******************************************************************************/
void setInverseState( bool newState ) {
  if ( newState != inverseState) {
    inverseState = newState;
  }
}

/*******************************************************************************
   Function: setVideoState
 *******************************************************************************/
void setVideoState( bool newState ) {
  if ( newState != videoState) {
    videoState = newState;
    osd->activateExternalVideo( videoState );
  }
}

/*******************************************************************************
   Function: newLine
 *******************************************************************************/
void newLine( void ) {
  curX = 0;
  curY++;
  if (curY >= MAX_LINES)
    curY = 0;
}

/*******************************************************************************
   Function: loadCharSet
             Loads the predefined characters of the variable tableOfAllCharacters
             into the EEPROM character memory of the max7456 circuit
 *******************************************************************************/
void loadCharSet( void ) {
  charact currentChar;      // Represents a character as stored in memory (byte[54])
  bool initialOsdState = osdState;
  setOsdState( false );     // Deactivate osd display.
  for (int i = 0 ; i <= 0xff; i++)
  {
    Max7456::getCARACFromProgMem(tableOfAllCharacters, i, currentChar);
    osd->sendCharacter(currentChar, i & 0xF0, i & 0xF0);
  }
  setOsdState( initialOsdState );
}

/*******************************************************************************
   Function: setup
             The Arduino setup function. Automatically run before loop is entered
 *******************************************************************************/
void setup() {
  // LED setup
  pinMode(LED_PIN, OUTPUT);
  digitalWrite( LED_PIN, LOW );   // Turn on the LED

  // MAX7456 setup
  SPI.begin();
  osd = new Max7456(CS_PIN);
  setBlinkState( blinkState );
  setOsdState( osdState );
  setInverseState( inverseState);
  setVideoState(videoState);
  loadCharSet();

  // Serial channel setup
  Serial.begin(9600);
}

/*******************************************************************************
   Function: loop
             Arduinos main loop function. May never return
 *******************************************************************************/
void loop() {
  bool activeCommand = false;
  bool waitingForX = false;
  bool waitingForY = false;
  char inChar;

  // Process serial data
  if (Serial.available()) {
    inChar = Serial.read();
    if (activeCommand) {
      switch (inChar) {
        case CMD_LOAD_CHARS:      loadCharSet(); break;
        case CMD_CLEAR_SCREEN:    osd->clearScreen(); break;
        case CMD_ENABLE_OSD:      setOsdState( true ); break;
        case CMD_DISABLE_OSD:     setOsdState(false); break;
        case CMD_ENABLE_VIDEO:    setVideoState( true ); break;
        case CMD_DISABLE_VIDEO:   setVideoState( false ); break;
        case CMD_ENABLE_BLINK:    setBlinkState( true ); break;
        case CMD_DISABLE_BLINK:   setBlinkState( false ); break;
        case CMD_ENABLE_REVERSE:  setInverseState( true ); break;
        case CMD_DISABLE_REVERSE: setInverseState( false ); break;
        case CMD_NEWLINE:         setInverseState( false ); break;
        case CMD_SET_X:           waitingForX = true; break;
        case CMD_SET_Y:           waitingForY = true; break;
        default: break;           // Unknown command - Just skip it
      }
      activeCommand = false;
    }
    else if (waitingForX) {
      curX = inChar;
      waitingForX = false;
    }
    else if (waitingForY) {
      curY = inChar;
      waitingForY = false;
    }
    else if ( inChar == CMD_CMD) {
      activeCommand = true;
    }
    else {
      osd->printMax7456Char( inChar, curX, curY, blinkState, inverseState );
      curX++;
      if (curX >= 30) { // 30 columns on screen
        curX = 0;
        curY++;
      }
      if (curY >= MAX_LINES) {
        curY = 0;
      }
    }
  }
  // Check if it is time to toggle the LED to show that we are alive
  if (millis() > systemPulseTimer) {
    systemPulseTimer = millis() + 500;
    digitalWrite(LED_PIN, !digitalRead(LED_PIN));
  }
}
